## boards/microchip/bz6/bz6_motor_control_board/Kconfig.defconfig
```kconfig
# Copyright (c) 2025 Microchip Technology Inc.
# SPDX-License-Identifier: Apache-2.0

if BOARD_BZ6_MOTOR_CONTROL_BOARD

config COUNTER
	default y if PM

endif
```

## boards/microchip/bz6/bz6_motor_control_board/board.yml
```yaml
# Copyright (c) 2025 Microchip Technology Inc.
# SPDX-License-Identifier: Apache-2.0

board:
  name: bz6_motor_control_board
  full_name: BZ6 Motor Control Board
  vendor: microchip
  socs:
    - name: pic32cx2051bz62132
```
